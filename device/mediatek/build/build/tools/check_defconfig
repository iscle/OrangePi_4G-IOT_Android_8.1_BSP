## device/mediatek/build/build/tools/check_defconfig
```kconfig
#!/bin/sh

TMPDIR=oo-$$
KERNEL_BASE=kernel-3.4
CONFIG_DIR=$KERNEL_BASE/arch/arm/configs
GEN_DEFCONFIG=gen_defconfig.py

if [ ! -d device/mediatek/build/config -o ! -d $CONFIG_DIR ]; then
    echo Must in AOSP ALPS dir.
    exit 1
fi

if [ -e device/mediatek/build/build/tools/check_option.py ]; then
    GEN_DEFCONFIG='device/mediatek/build/build/tools/check_option.py gen_defconfig.py'
fi

CONFIGS=`cd ${CONFIG_DIR} ; ls mt*`
for i in $CONFIGS ; do
    PROJ=${i/%_defconfig/}
    PROJ=${PROJ/%_debug/}
    PROJECTCONFIG=device/mediatek/$PROJ/ProjectConfig.mk
    if [ -e ${PROJECTCONFIG} ]; then
    	pushd $KERNEL_BASE
    	mkdir $TMPDIR
    	rm $TPMDIR/.config
    	make $i O=$TMPDIR
    	popd
    	$GEN_DEFCONFIG -c $PROJECTCONFIG >> $KERNEL_BASE/$TMPDIR/.config
    	pushd $KERNEL_BASE
    	make oldconfig O=$TMPDIR
    	cmp $TMPDIR/.config arch/arm/configs/$i
    	RET=$?
    	if [ $RET != 0 ]; then
    	    echo Update $i
    	    cp $TMPDIR/.config arch/arm/configs/$i
    	    p4 edit arch/arm/configs/$i
    	fi
    	popd
    fi
done
rm -rf $KERNEL_BASE/$TMPDIR
```

## device/mediatek/build/build/tools/update_defconfig
```kconfig
#!/bin/bash

TMPDIR=oo-$$
KERNEL_BASE=kernel-3.10
CONFIG_DIR=$KERNEL_BASE/arch/arm/configs
CONFIG64_DIR=$KERNEL_BASE/arch/arm64/configs

if [ ! -d device/mediatek/build/config -o ! -d $CONFIG_DIR ]; then
    echo Must in AOSP ALPS dir.
    exit 1
fi

# For arm32
CONFIGS=`cd ${CONFIG_DIR} ; ls mt* k2* k7* k8* k9* aubest* aux82* avago82* d209* demo92* demo95* evb65* evb67* hero2* muse* ratch* rio5* stella* tb65* tinno82*`
for i in $CONFIGS ; do
    pushd $KERNEL_BASE
    mkdir $TMPDIR
    TARGET_ARCH=arm make $i O=$TMPDIR

    cmp $TMPDIR/.config arch/arm/configs/$i
    RET=$?
    if [ $RET != 0 ]; then
        echo Update $i
        cp -f $TMPDIR/.config arch/arm/configs/$i
        p4 edit arch/arm/configs/$i
    fi
    popd
done


# For arm64
CONFIGS64=`cd ${CONFIG64_DIR} ; ls k2* evb* fpga* aubest*`
for i in $CONFIGS64 ; do
    pushd $KERNEL_BASE
    mkdir $TMPDIR
    TARGET_ARCH=arm64 make $i O=$TMPDIR

    cmp $TMPDIR/.config arch/arm64/configs/$i
    RET=$?
    if [ $RET != 0 ]; then
        echo Update $i
        cp -f $TMPDIR/.config arch/arm64/configs/$i
        p4 edit arch/arm64/configs/$i
    fi
    popd
done

rm -rf $KERNEL_BASE/$TMPDIR
```

## kernel-3.18/drivers/input/touchscreen/mediatek/focaltech/Kconfig
```kconfig
#
# Touchscreen driver configuration
#
config TOUCHSCREEN_MTK_FOCALTECH
    bool "Focaltech Ts for Mediatek"
    depends on I2C
    default n
    help
      Say Y here if you have Focaltech touch panel.
      If unsure, say N.
      
config TOUCHSCREEN_MTK_FTS_DIRECTORY
    string "Focaltech ts directory name"
    default "focaltech_touch"
    depends on CONFIG_TOUCHSCREEN_MTK_FOCALTECH
    
```

## kernel-3.18/drivers/input/touchscreen/mediatek/ft6336s/Kconfig
```kconfig
#
# Touchscreen driver configuration
#
if TOUCHSCREEN_MTK_FT6336S

config FT6336S_FIRMWARE
	string "FT6336S for Mediatek firmware"

config TPD_ROTATE_90
	bool "ft6336s for Mediatek package"
	default n
	help
	  Say Y here if you have ft6336s touch panel TPD_ROTATE_90.

	  If unsure, say N.

	  To compile this dirver as a module, choose M here: the
	  module will be called.

config TPD_ROTATE_180
	bool "ft6336s for Mediatek package"
	default n
	help
	  Say Y here if you have ft6336s touch panel TPD_ROTATE_180.

	  If unsure, say N.

	  To compile this dirver as a module, choose M here: the
	  module will be called.

config TPD_ROTATE_270
	bool "ft6336s for Mediatek package"
	default n
	help
	  Say Y here if you have ft6336s touch panel TPD_ROTATE_270.

	  If unsure, say N.

	  To compile this dirver as a module, choose M here: the
	  module will be called.

config FT_AUTO_UPGRADE_SUPPORT
	bool "ft6336s for Mediatek package"
	default n
	help
	  Say Y here if you have ft6336s touch panel FT_AUTO_UPGRADE_SUPPORT.

	  If unsure, say N.

	  To compile this dirver as a module, choose M here: the
	  module will be called.

config CUST_FTS_APK_DEBUG
	bool "ft6336s for Mediatek package"
	default n
	help
	  Say Y here if you have ft6336s touch panel CUST_FTS_APK_DEBUG.

	  If unsure, say N.

	  To compile this dirver as a module, choose M here: the
	  module will be called.

config TPD_HAVE_CALIBRATION
	bool "ft6336s for Mediatek package"
	default n
	help
	  Say Y here if you have ft6336s touch panel TPD_HAVE_CALIBRATION.

	  If unsure, say N.

	  To compile this dirver as a module, choose M here: the
	  module will be called.

config TPD_CUSTOM_CALIBRATION
	bool "ft6336s for Mediatek package"
	default n
	help
	  Say Y here if you have ft6336s touch panel TPD_CUSTOM_CALIBRATION.

	  If unsure, say N.

	  To compile this dirver as a module, choose M here: the
	  module will be called.
endif
```

## kernel-3.18/drivers/misc/mediatek/flashlight/Kconfig
```kconfig
config MTK_FLASHLIGHT
  tristate CONFIG_MTK_FLASHLIGHT
  default n
  help
    CONFIG_MTK_FLASHLIGHT
    
config MTK_MAIN_TRUE_FLASHLIGHT
  bool MTK_MAIN_TRUE_FLASHLIGHT
  default n
  help
    MTK_MAIN_TRUE_FLASHLIGHT
    
config RUNYEE_MAIN_TRUE_FLASHLIGHT_CURRENT
	int "flashlight current"
	range 1 16
	default "15"
	---help---
	  time 220ms val: 1->100%, 2->90%, 3->80%, 4->70%
	                  5->60%, 6->50%, 7->40%, 8->30%
	  time 1.3s val:  9->100%, 10->90%, 11->80%, 12->70%
	                  13->60%, 14->50%, 15->40%, 16->30%
	                  	  
config MTK_SUB_TRUE_FLASHLIGHT
  bool MTK_SUB_TRUE_FLASHLIGHT
  default n
  help
    MTK_SUB_TRUE_FLASHLIGHT
       
config CUSTOM_KERNEL_FLASHLIGHT
        string "CUSTOM_KERNEL_FLASHLIGHT"
        help
          Kernel space cameara flashlight driver. You can use this driver
          choose cameara flashlight type.

config MTK_FLASHLIGHT_USE_MODULE
	bool "Mediatek flashlight driver build as module"
	default n
	help
	  Say Y here if you want to build flashlight driver as xxx.ko.

	  If unsure, say N.

	  To compile this dirver as a module,
	  It will be called by insmod xxx.ko in init.rc.

source "drivers/misc/mediatek/flashlight/richtek/Kconfig"
```

## kernel-3.18/drivers/misc/mediatek/hdmi_runyee/Kconfig
```kconfig
config CUSTOM_KERNEL_HDMI_RUNYEE
	bool "CUSTOM_KERNEL_HDMI_RUNYEE"
	help
	  hdmi runyee sensor driver

source "drivers/misc/mediatek/hdmi_runyee/lt8912b/Kconfig"
```

## kernel-3.18/drivers/misc/mediatek/hdmi_runyee/lt8912b/Kconfig
```kconfig
config MTK_HDMI_RUNYEE_LT8912B
	bool "MTK_HDMI_RUNYEE_LT8912B"
	default n
	help
	  It support different receiver sensor.
          If this option is set,
	  it will support
          HDMI_RUNYEE_LT8912B sensor.
```

## kernel-3.18/drivers/misc/mediatek/imgsensor/src/double/Kconfig
```kconfig
config RUNYEE_DOUBLE_IMGSENSOR
	tristate "enable RUNYEE_DOUBLE_IMGSENSOR driver"
	default n
	help
	  It support different sensor.
          If this option is set to m,
          it will build module.

source "drivers/misc/mediatek/imgsensor/src/double/main/Kconfig"
source "drivers/misc/mediatek/imgsensor/src/double/sub/Kconfig"          
```

## kernel-3.18/drivers/misc/mediatek/imgsensor/src/double/sub/Kconfig
```kconfig
config RUNYEE_SDOUBLE_IMGSENSOR_GC0310
	tristate "enable RUNYEE_SDOUBLE_IMGSENSOR_GC0310 driver"
	default n
	help
	  It support different sensor.
          If this option is set to m,
          it will build module.
          
```

## kernel-3.18/drivers/misc/mediatek/receiver/Kconfig
```kconfig
config CUSTOM_KERNEL_RECEIVER
	bool "CUSTOM_KERNEL_RECEIVER"
	help
	  ir receiver sensor driver

source "drivers/misc/mediatek/receiver/vs838/Kconfig"
config MTK_RECEIVER_VS838
	bool "MTK_RECEIVER_VS838"
	default n
	help
	  It support different receiver sensor.
          If this option is set,
	  it will support
          MTK_RECEIVER_VS838 sensor.
```

## kernel-3.18/drivers/misc/mediatek/receiver/vs838/Kconfig
```kconfig
config MTK_RECEIVER_VS838
	bool "MTK_RECEIVER_VS838"
	default n
	help
	  It support different receiver sensor.
          If this option is set,
	  it will support
          MTK_RECEIVER_VS838 sensor.
```

## kernel-3.18/drivers/misc/mediatek/sensors-1.0/accelerometer/mir3da/Kconfig
```kconfig
config MTK_MIR3DA
	bool "MTK_MIR3DA for MediaTek package"
	default n
	help
	  The MIR3DA is a highly integrated,
	  low power internal measurement unit
	  that provides precise acceleration
	  measurement.
	  this config will turn on accelerometer feature.
```

## kernel-3.18/drivers/misc/mediatek/sensors-1.0/accelerometer/stk8baxx/Kconfig
```kconfig
config MTK_STK8BAXX
	bool "MTK_STK8BAXX for MediaTek package"
	default n
	help
	  The STK8BA50 is a highly integrated,
	  low power internal measurement unit
	  that provides precise acceleration
	  measurement.
	  this config will turn on accelerometer feature.
```
